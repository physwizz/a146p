## kernel/kernel_device_modules-6.6/arch/arm64/configs/a14xm_00_defconfig
```kconfig
# CONFIG_RODATA_FULL_DEFAULT_ENABLED is not set
# CONFIG_ARM64_E0PD is not set
CONFIG_SEC_DEBUG_LEGACY_LK_RESET=y
```

## kernel/kernel_device_modules-6.6/drivers/input/SAR/A96T376/Kconfig
```kconfig
# SPDX-License-Identifier: GPL-2.0-only
#
# Input core configuration
#

config INPUT_A96T376
    tristate "Support for A96T376 sar sensor"
    help
      Say Y to enable support for A96T376.
```

## kernel/kernel_device_modules-6.6/drivers/input/SAR/Kconfig
```kconfig
# SPDX-License-Identifier: GPL-2.0-only
#
# Input core configuration
#
config TYHX_HX9035
    tristate "Support for hx9036 sar sensor"
    help
        Say Y to enable support for TYHX_HX9035.

config INPUT_A96T376
    tristate "Support for A96T376 sar sensor"
    help
        Say Y to enable support for A96T376.

config SX9328_SAR
    tristate "Support for SX9328 sar sensor"
    help
        Say Y to enable support for SX9328.

config HX9023S_SAR
    tristate "Support for HX9023S sar sensor"
    help
        Say Y to enable support for HX9023S_SAR.

config SX9375_SAR
    tristate "SX937X_SAR_sensor"
    help
        Say Y to enable the SAR detection application, if N here not to use the
        this SAR sensor

config SX9338_SAR
    tristate "Support for SX9338 sar sensor"
    help
      Say Y to enable support for SX9338.

source "$(KCONFIG_EXT_PREFIX)drivers/input/SAR/hx9035/Kconfig"
source "$(KCONFIG_EXT_PREFIX)drivers/input/SAR/A96T376/Kconfig"
source "$(KCONFIG_EXT_PREFIX)drivers/input/SAR/hx9023_sar/Kconfig"
source "$(KCONFIG_EXT_PREFIX)drivers/input/SAR/sx9328_sar/Kconfig"
source "$(KCONFIG_EXT_PREFIX)drivers/input/SAR/sx9338_sar/Kconfig"
source "$(KCONFIG_EXT_PREFIX)drivers/input/SAR/sx9375_sar/Kconfig"
```

## kernel/kernel_device_modules-6.6/drivers/input/SAR/hx9023_sar/Kconfig
```kconfig
# SPDX-License-Identifier: GPL-2.0-only
#
# Input core configuration
#
config HX9023S_SAR
    tristate "Support for HX9023S sar sensor"
    help
      Say Y to enable support for HX9023S_SAR.
```

## kernel/kernel_device_modules-6.6/drivers/input/SAR/hx9035/Kconfig
```kconfig
# SPDX-License-Identifier: GPL-2.0-only
#
# Input core configuration
#

config TYHX_HX9035
    tristate "Support for hx9036 sar sensor"
    help
      Say Y to enable support for TYHX_HX9035.
```

## kernel/kernel_device_modules-6.6/drivers/input/SAR/sx9328_sar/Kconfig
```kconfig
# SPDX-License-Identifier: GPL-2.0-only
#
# Input core configuration
#
config SX9328_SAR
    tristate "Support for SX9328 sar sensor"
    help
      Say Y to enable support for SX9328.
```

## kernel/kernel_device_modules-6.6/drivers/input/SAR/sx9338_sar/Kconfig
```kconfig
# SPDX-License-Identifier: GPL-2.0-only
#
# Input core configuration
#
config SX9338_SAR
    tristate "Support for SX9338 sar sensor"
    help
      Say Y to enable support for SX9338.
```

## kernel/kernel_device_modules-6.6/drivers/input/SAR/sx9375_sar/Kconfig
```kconfig
# SPDX-License-Identifier: GPL-2.0-only
#
# Input core configuration
#
config SX9375_SAR
    tristate "SX937X_SAR_sensor"
    help
        Say Y to enable the SAR detection application, if N here not to use the
        this SAR sensor
```

## kernel/kernel_device_modules-6.6/drivers/input/touchscreen/ICNL9916C/Kconfig
```kconfig
# SPDX-License-Identifier: GPL-2.0-only
#
# Touchscreen driver configuration
#

config TOUCHSCREEN_ICNL9916C
       tristate "CHIPONE TOUCHSCREEN"
       default n
       help
         Say Y here if you have chipone touch panel.
         If unsure, say N.
```

## kernel/kernel_device_modules-6.6/drivers/input/touchscreen/ILI7807S/Kconfig
```kconfig
#
# ILI7807S Touchscreen driver configuration
#
config TOUCHSCREEN_ILI7807S
    tristate "ILI7807S Touchscreen"
    default n
    help
      Say Y here if you have ILI7807S touch panel.
      If unsure, say N.
```

## kernel/kernel_device_modules-6.6/drivers/input/touchscreen/Kconfig
```kconfig
# SPDX-License-Identifier: GPL-2.0-only
#
# Touchscreen driver configuration
#

if INPUT_TOUCHSCREEN

config TOUCHSCREEN_MTK_TOUCH
       string "Touch IC name for Mediatek package"
       help
         Set touch IC name if you have touch panel.

         To compile this dirver for used touch IC.

config TOUCHSCREEN_MT6985_ALPHA_SUPPORT
       tristate "Specify Alpha Touch Platform is mt6985"
       help
         Select Alpha Touch Platform is mt6985.
         To compile this dirver for used touch IC.
         Set Y or M to select this feature for specific platform-mt6985,
         and set N to disable.

config TOUCHSCREEN_ILITEK_TOUCH
       tristate "ILITEK TOUCHSCREEN"
       help
         Set Y or M to select this feature for touch compile,
         and set N to disable.

config TOUCHSCREEN_BOTAI_MULTI_TOUCH
       tristate "GT9XX MULTIPLE TOUCHSCREEN"
       help
         Set Y or M to select this feature for touch compile,
         and set N to disable.for BoTai touch feature.

config TOUCHSCREEN_GT9XX
       tristate "GT9XX TOUCHSCREEN FOR CAR SERDES TOUCH"
       help
         Set Y or M to select this feature for touch compile,
         and set N to disable.for car serdes touch feature.

config TOUCHSCREEN_FTS_FT8722
       tristate "focaltech Touchscreen"
       help
         Say Y here if you have Focaltech touch panel.
         If unsure, say N.

config TOUCHSCREEN_FTS_FT8057S
       tristate "focaltech Touchscreen"
       help
         Say Y here if you have Focaltech touch panel.
         If unsure, say N.

config TOUCHSCREEN_NT36528_HOSTDL_SPI
        tristate "NT36528 for Mediatek package"
        default n
        help
          Say Y here if you have NT36672C touch panel.

          If unsure, say N.

          To compile this dirver as a module, choose M here: the
          module will be called.

config TOUCHSCREEN_ILI7807S
       tristate "ILI7807S Touchscreen"
       help
         Say Y here if you have ILI7807S touch panel.
         If unsure, say N.

config TOUCHSCREEN_HIMAX_CHIPSET
       tristate "hx83112f Touchscreen"
       help
         Say Y here if you have hx83112f touch panel.
         If unsure, say N.

source "$(KCONFIG_EXT_PREFIX)drivers/input/touchscreen/TD4160/Kconfig"

config TOUCHSCREEN_GCORE
       tristate "GCORE Touchscreen"
       help
         Say Y here if you have GCORE touch panel.
         If unsure, say N.

config TOUCHSCREEN_ICNL9916C
       tristate "CHIPONE Touchscreen"
       default n
       help
         Say Y here if you have chipone touch panel.
         If unsure, say N.

config TP_SEC_CMD
       tristate "TP cmd driver"

config TP_NOTIFY
       tristate "TP notifier driver"

source "$(KCONFIG_EXT_PREFIX)drivers/input/touchscreen/ICNL9916C/Kconfig"
source "$(KCONFIG_EXT_PREFIX)drivers/input/touchscreen/galaxycore/Kconfig"
source "$(KCONFIG_EXT_PREFIX)drivers/input/touchscreen/FT8057S/Kconfig"
source "$(KCONFIG_EXT_PREFIX)drivers/input/touchscreen/NT36528/Kconfig"
source "$(KCONFIG_EXT_PREFIX)drivers/input/touchscreen/FT8722/Kconfig"
source "$(KCONFIG_EXT_PREFIX)drivers/input/touchscreen/ILI7807S/Kconfig"
source "$(KCONFIG_EXT_PREFIX)drivers/input/touchscreen/hx83112f/Kconfig"
config TOUCHSCREEN_FOCALTECH_TOUCH
       tristate "FOCALTECH TOUCHSCREEN"
       help
         Set Y or M to select this feature for touch compile,
         and set N to disable.for car serdes touch feature.

source "$(KCONFIG_EXT_PREFIX)drivers/input/touchscreen/BoTai_Multi_Touch/Kconfig"
source "$(KCONFIG_EXT_PREFIX)drivers/input/touchscreen/GT9966/Kconfig"
source "$(KCONFIG_EXT_PREFIX)drivers/input/touchscreen/gt9xx/Kconfig"
source "$(KCONFIG_EXT_PREFIX)drivers/input/touchscreen/ILITEK/Kconfig"
source "$(KCONFIG_EXT_PREFIX)drivers/input/touchscreen/synaptics_dsx_96789/Kconfig"
source "$(KCONFIG_EXT_PREFIX)drivers/input/touchscreen/synaptics_dsx_96851/Kconfig"
source "$(KCONFIG_EXT_PREFIX)drivers/input/touchscreen/NT36532/Kconfig"
source "$(KCONFIG_EXT_PREFIX)drivers/input/touchscreen/gt9895_brl/Kconfig"
source "$(KCONFIG_EXT_PREFIX)drivers/input/touchscreen/synaptics_tcm2_sec/Kconfig"
source "$(KCONFIG_EXT_PREFIX)drivers/input/touchscreen/GT6936/Kconfig"

endif
```

## kernel/kernel_device_modules-6.6/drivers/input/touchscreen/galaxycore/Kconfig
```kconfig
config TOUCHSCREEN_GCORE
       tristate "GCORE Touchscreen"
       help
         Say Y here if you have GCORE touch panel.
         If unsure, say N.
```

## kernel/kernel_device_modules-6.6/drivers/misc/mediatek/sensor/1.0/situation/Kconfig
```kconfig
config CUSTOM_KERNEL_SITUATION
	bool "mediatek situation sensor tag"
	help
	  Kernel space support situation sensor driver.
	  If the platform is supported for gesture, this
	  configuration should be configured, and the situation
	  driver configuration should be configured as well.

config LIFT_TO_WAKE
    bool  "lift to wake for ss"
    help
        A wake is a device,
        usually portable and electronic
        or electromechanical,
        that detect device is picked up with 35 degree.

config SMART_ALERT_HUB
	bool  "smart_alert_hub for MediaTek package"
	help
	  smart_alert is a device,
	  usually portable and electronic
	  or electromechanical,
	  that detect device is picked up with 35 degree.

source "$(KCONFIG_EXT_PREFIX)drivers/misc/mediatek/sensor/1.0/situation/situation_hub/Kconfig"
source "$(KCONFIG_EXT_PREFIX)drivers/misc/mediatek/sensor/1.0/situation/lift_to_wake/Kconfig"
source "$(KCONFIG_EXT_PREFIX)drivers/misc/mediatek/sensor/1.0/situation/smart_alert/Kconfig"
```

## kernel/kernel_device_modules-6.6/drivers/nfc/Kconfig
```kconfig
# SPDX-License-Identifier: GPL-2.0

source "$(KCONFIG_EXT_PREFIX)drivers/nfc/pn557/Kconfig"
```

## kernel/kernel_device_modules-6.6/drivers/wingtechsh/Kconfig
```kconfig
config WT_PROJECT_S96818AA1
        bool "Define for S96818AA1"
	help
	Say Y here for distinguish different projects

config WT_PROJECT_S96818BA1
        bool "Define for S96818BA1"
	help
	Say Y here for distinguish different projects

config WT_PROJECT_S96901AA1
	bool "Define for S96901AA1"
	help
	 Say Y here for distinguish different projects

config WT_PROJECT_S96902AA1
	bool "Define for S96902AA1"
	help
	 Say Y here for distinguish different projects

config WT_PROJECT_S96901WA1
	bool "Define for S96901WA1"
	help
	 Say Y here for distinguish different projects
```
